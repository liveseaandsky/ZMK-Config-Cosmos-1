## boards/shields/Cosmos-1/Kconfig.shield
```kconfig
# No whitespace after the comma or in your part name!
config Cosmos-1_Left
    def_bool $(shields_list_contains,Cosmos-1_Left)

# No whitespace after the comma or in your part name!
config Cosmos-1_Right
    def_bool $(shields_list_contains,Cosmos-1_Right)
```

## boards/shields/Cosmos1/Kconfig.defconfig
```kconfig
if Cosmos1_dongle

# Name must be less than 16 characters long!
config ZMK_KEYBOARD_NAME
    default "Cosmos1"

config ZMK_SPLIT_ROLE_CENTRAL
    default y

endif

if Cosmos1_Left || Cosmos1_Right || Cosmos1_dongle

config ZMK_SPLIT
    default y

endif
```

## boards/shields/Cosmos1/Kconfig.shield
```kconfig
# No whitespace after the comma or in your part name!
config Cosmos1_Left
    def_bool $(shields_list_contains,Cosmos1_left)

# No whitespace after the comma or in your part name!
config Cosmos1_Right
    def_bool $(shields_list_contains,Cosmos1_right)
```

## boards/shields/cosmos/Kconfig.defconfig
```kconfig
if cosmos_dongle

# Name must be less than 16 characters long!
config ZMK_KEYBOARD_NAME
    default "Cosmos"

config ZMK_SPLIT_ROLE_CENTRAL
    default y

endif

if cosmos_left || cosmos_right || cosmos_dongle
# Other settings

config ZMK_SPLIT
    default y

config ZMK_POINTING
    default y

endif

if SHIELD_COSMOS_RIGHT
config SPI
    default y
endif
```

## boards/shields/cosmos/Kconfig.shield
```kconfig
# No whitespace after the comma or in your part name!
config cosmos_left
    def_bool $(shields_list_contains,cosmos_left)

# No whitespace after the comma or in your part name!
config cosmos_right
    def_bool $(shields_list_contains,cosmos_right)

config cosmos_dongle
    def_bool $(shields_list_contains,cosmos_dongle)
```

## boards/shields/cosmos1/Kconfig.defconfig
```kconfig
if cosmos1_dongle

# Name must be less than 16 characters long!
config ZMK_KEYBOARD_NAME
    default "Cosmos"

config ZMK_SPLIT_ROLE_CENTRAL
    default y

endif

if cosmos1_Left || cosmos1_Right || cosmos1_dongle

config ZMK_SPLIT
    default y

endif
```

## boards/shields/cosmos1/Kconfig.shield
```kconfig
# No whitespace after the comma or in your part name!
config cosmos1_left
    def_bool $(shields_list_contains,cosmos1_left)

# No whitespace after the comma or in your part name!
config cosmos1_right
    def_bool $(shields_list_contains,cosmos1_right)

config cosmos1_dongle
    def_bool $(shields_list_contains,cosmos1_dongle)
```

## config/west.yml
```yaml
manifest:
  remotes:
    - name: zmkfirmware
      url-base: https://github.com/zmkfirmware
    - name: liveseaandsky
      url-base: https://github.com/liveseaandsky
    - name: carrefinho                            # Prospector Dongle
      url-base: https://github.com/carrefinho
    - name: badjeff
      url-base: https://github.com/badjeff
    - name: efogdev
      url-base: https://github.com/efogdev/ # Trackball Sensor Rotation
    - name: dhruvinsh
      url-base: https://github.com/dhruvinsh
    # Additional modules containing boards/shields/custom code can be listed here as well
    # See https://docs.zephyrproject.org/3.2.0/develop/west/manifest.html#projects
  projects:
    - name: zmk
      remote: zmkfirmware
      revision: main
      import: app/west.yml
    - name: ZMK-Config-Cosmos-1
      remote: liveseaandsky
      revision: main
    - name: zmk-pmw3610-driver
      remote: badjeff
      revision: main
    - name: prospector-zmk-module
      remote: carrefinho
      revision: feat/new-status-screens 
    - name: zmk-input-processor-rotate-plane
      remote: efogdev
      revision: main
    - name: zmk-tri-state
      remote: dhruvinsh
      revision: main
  self:
    path: config
```
